## sdkconfig.defaults
```kconfig
# Bluetooth Configuration
CONFIG_BT_ENABLED=y
CONFIG_BT_NIMBLE_ENABLED=y
CONFIG_BT_CONTROLLER_ENABLED=y

# NimBLE Settings
CONFIG_BT_NIMBLE_MAX_CONNECTIONS=1
CONFIG_BT_NIMBLE_MAX_BONDS=3
CONFIG_BT_NIMBLE_MAX_CCCDS=8
CONFIG_BT_NIMBLE_PINNED_TO_CORE_0=y
CONFIG_BT_NIMBLE_TASK_STACK_SIZE=4096

# Bluetooth Host Configuration
CONFIG_BT_NIMBLE_ROLE_PERIPHERAL=y
CONFIG_BT_NIMBLE_ROLE_BROADCASTER=y

# Security
CONFIG_BT_NIMBLE_SM_LEGACY=y
CONFIG_BT_NIMBLE_SM_SC=y
CONFIG_BT_NIMBLE_SVC_GAP_DEVICE_NAME="Music Remote"

# Log Levels (set to INFO for production, DEBUG for development)
CONFIG_LOG_DEFAULT_LEVEL_INFO=y
CONFIG_LOG_MAXIMUM_LEVEL_INFO=y

# Optional: Reduce log output in production
# CONFIG_LOG_DEFAULT_LEVEL_WARN=y

# FreeRTOS
CONFIG_FREERTOS_HZ=1000
CONFIG_FREERTOS_WATCHPOINT_END_OF_STACK=y

# ESP32 Configuration
CONFIG_ESP_MAIN_TASK_STACK_SIZE=4096
CONFIG_ESP_SYSTEM_EVENT_TASK_STACK_SIZE=2304

# NVS (Non-Volatile Storage for bonding)
CONFIG_NVS_ENCRYPTION=n

# Disable Bluetooth Classic (BLE only)
CONFIG_BT_CLASSIC_ENABLED=n
CONFIG_BT_A2DP_ENABLE=n
CONFIG_BT_SPP_ENABLED=n

# Power Management (optional, uncomment for battery operation)
# CONFIG_PM_ENABLE=y
# CONFIG_FREERTOS_USE_TICKLESS_IDLE=y

# Compiler optimizations
CONFIG_COMPILER_OPTIMIZATION_SIZE=y

# Serial Console
CONFIG_ESP_CONSOLE_UART_NUM_0=y
CONFIG_ESP_CONSOLE_UART_BAUDRATE_115200=y

# Bootloader
CONFIG_BOOTLOADER_LOG_LEVEL_WARN=y

# Partition Table
CONFIG_PARTITION_TABLE_SINGLE_APP=y

# Flash Size (adjust based on your module)
CONFIG_ESPTOOLPY_FLASHSIZE_4MB=y
```
